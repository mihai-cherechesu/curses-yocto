## build/conf/bblayers.conf
```bitbake
BBLAYERS ?= " \
    /home/student/yocto/./layers/meta-si \
    /home/student/yocto/layers/meta-openembedded/meta-oe \
    /home/student/yocto/layers/meta-openembedded/meta-python \
    /home/student/yocto/layers/meta-raspberrypi \
    /home/student/yocto/layers/poky/meta \
    /home/student/yocto/layers/poky/meta-poky \
    /home/student/yocto/layers/poky/meta-yocto-bsp"
BBPATH ?= "${TOPDIR}"
BBFILES ??= ""
```

## build/conf/local.conf
```bitbake
# meta-silabs
DL_DIR = "/home/student/tmp/downloads"
SSTATE_DIR = "/home/student/sstate-cache"
INHERIT += "rm_work"

MACHINE ??= "qemuarm"
DISTRO ??= "poky"
BBMULTICONFIG ?= ""
```
